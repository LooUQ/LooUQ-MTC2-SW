## boards/dts/bindings/gpio-inputs.yaml
```yaml
# Copyright (c) 2018, Linaro Limited
# SPDX-License-Identifier: Apache-2.0

compatible: "gpio-inputs"

child-binding:
    description: GPIO input child node
    properties:
       gpios:
          type: phandle-array
          required: true
       label:
          required: false
          type: string
          description: |
            Human readable string describing the pin. It can be used by an
            application to identify this pin or to retrieve its number/index
            (i.e. child node number) on the parent device.
```

## boards/dts/bindings/loouq-mtc2,master-dvcselect.yaml
```yaml
description: |
  The MTC.2 interface utilizes a Device Select pin, similar to SPI-CS, to multiplex 
  multiple slave shield boards. MTC.2 devices have a Device Select (dvcselect) input
  on pin 3 of the M.2 connector. When dvcselect is active (HIGH) this enables the 
  host/shield communications.

  For systems with multiple shields (slave/peripheral devices) the host system board
  typically has a I2C/GPIO expander that sources dvcselect. Alternately the host could 
  dedicate one or more GPIO pins to select peripheral shields. If assigning GPIO pins
  to dvcselect function
  

compatible: "loouq-mtc2,master-dvcselect"

include: base.yaml

child-binding:
  description: Shield/peripheral device select child node
  properties:
    gpios:
      type: phandle-array
      required: true
    label:
      type: string
      description: |
        Human readable string describing the shield/peripheral being controlled.

# properties:

#   gpios:
#     type: phandle-array
#     required: true
#     description: |
#       GPIO to use as the host device select signal to select an individual shield.
```

## boards/mtc2_n9151/board.yml
```yaml
board:
  name: mtc2n9151
  full_name: MTC2-N9151
  vendor: loouq
  socs:
  - name: nrf9151
    variants:
    - name: 'ns'
```

## drivers/RGBI/drivers/rgbi/Kconfig
```kconfig
# Copyright (c) 2024 Nordic Semiconductor ASA
# Copyright (c) 2025 LooUQ Incorporated
# SPDX-License-Identifier: Apache-2.0

menuconfig RGBI
	bool "RGB Indicator device drivers"
	help
	  This option enables the rgbi custom driver class.

if RGBI

config RGBI_INIT_PRIORITY
	int "RGB Indicator device drivers init priority"
	# default KERNEL_INIT_PRIORITY_DEVICE
    default 95
	help
	  RGBI device drivers init priority.

module = RGBI
module-str = rgbi
source "subsys/logging/Kconfig.template.log_config"

config RGBI_SPI_WS2812
	bool "SPI-controlled WS2812 RGB LED"
	default y
	depends on DT_HAS_RGBI_SPI_WS2812_ENABLED
	select SPI
	help
	  Enable this option to use the SPI-WS2812 RGB LED driver. 

endif # RGBI
```

## drivers/RGBI/dts/bindings/loouq,rgbi-spi-ws2812.yaml
```yaml
# Copyright (c) 2024 Nordic Semiconductor ASA
# Copyright (c) 2025 LooUQ Incorporated
# SPDX-License-Identifier: Apache-2.0

description: |
  A binding for a SPI-controlled WS2812 RGB LED. 
  
  Example definition in devicetree:

    loouq,rgbi-spi-ws2812 {
        compatible = "rgbi-spi-ws2812";
        ws2812 = <&ws2812>
    };

compatible: "rgbi-spi-ws2812"

include: base.yaml

properties:
  ws2812-dev-id:
    type: phandle
    required: false
    description: WS2812 RGB indicator LED.

  test-val:
    type: int
    description: just testing
```

## modules/rgb-indicator/Kconfig
```kconfig
# Copyright (c) 2024 Nordic Semiconductor ASA
# SPDX-License-Identifier: Apache-2.0

menuconfig RGBINDICATOR
	bool "RGB Indicator device drivers"
	help
	  This option enables the RGB indicator custom driver class.

if RGBINDICATOR

module = RGBINDICATOR
module-str = rgbindicator0
source "subsys/logging/Kconfig.template.log_config"

# rsource "Kconfig.gpio_led"

endif # RGBINDICATOR
```
