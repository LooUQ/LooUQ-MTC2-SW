/*
 * Copyright (c) 2023 Nordic Semiconductor ASA
 *
 * SPDX-License-Identifier: Apache-2.0
 */

/dts-v1/;
/* SoC dtsi was renamed in NCS v3.3.1: nrf9151ns_laca -> nrf9151_ns_laca.
 * Pick whichever the active SDK provides so this board builds on both.
 */
#if __has_include(<nordic/nrf9151_ns_laca.dtsi>)
#include <nordic/nrf9151_ns_laca.dtsi>
#else
#include <nordic/nrf9151ns_laca.dtsi>
#endif
#include "mtc2n9151_nrf9151_common.dtsi"

/ {
	chosen {
		zephyr,flash = &flash0;
		zephyr,sram = &sram0_ns_app;
		zephyr,code-partition = &slot0_ns_partition;
	};
};

/* Disable UART1, because it is used by default in TF-M */
&uart1 {
	status = "disabled";
};
