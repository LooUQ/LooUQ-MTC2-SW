## CMakeLists.txt
```
# SPDX-License-Identifier: Apache-2.0

cmake_minimum_required(VERSION 3.20.0)
set(ZEPHYR_EXTRA_MODULES c:/ncs/loouq/modules/rgb-indicator)
find_package(Zephyr REQUIRED HINTS $ENV{ZEPHYR_BASE})
project(rgb-indicator)

target_sources(app PRIVATE src/main.c)
```

## prj.conf
```kconfig
CONFIG_GPIO=y

# LooUQ host boards have various add-on functionality connected via
# the "host extension" interface (HX). This is implemented with I2C
# typically assigned to I2C3 in the devicetree board overlay.
CONFIG_I2C=y

# Most LooUQ host boards have a TI LED controller for RGB display
# CONFIG_RGBINDICATOR=y

#Sense1 add-on option has ST-ISM330DHCX and Bosch-BMP581
# CONFIG_ISM330DHCX=y
# CONFIG_BMP581=y
```

## dts/bindings/gpio-inputs.yaml
```yaml
# Copyright (c) 2018, Linaro Limited
# SPDX-License-Identifier: Apache-2.0

compatible: "gpio-inputs"
description: |
  Group of GPIO input nodes (switch input, data ready, etc.).

child-binding:
  description: GPIO input node

  properties:
    gpios:
      type: phandle-array
      required: true
    label:
      required: false
      type: string
      description: |
        Human readable string describing the pin. It can be used by an
        application to identify this pin or to retrieve its number/index
        (i.e. child node number) on the parent device.
```

## dts/bindings/gpio-outputs.yaml
```yaml
# Copyright (c) 2018, Linaro Limited
# SPDX-License-Identifier: Apache-2.0

compatible: "gpio-outputs"

description: |
  Group of GPIO output nodes (LEDs, relays, etc.).

    Each LED is defined in a child node of the gpio-leds node.

  Here is an example which defines three LEDs in the node /leds:

  / {
  	leds {
  		compatible = "gpio-leds";
  		led_0 {
  			gpios = <&gpio0 1 GPIO_ACTIVE_LOW>;
  		};
  		led_1 {
  			gpios = <&gpio0 2 GPIO_ACTIVE_HIGH>;
  		};
  		led_2 {
  			gpios = <&gpio1 15 (GPIO_PULL_UP | GPIO_ACTIVE_LOW)>;
  		};
  	};
  };

  Above:
  - led_0 is pin 1 on gpio0. The LED is on when the pin is low,
    and off when the pin is high.
  - led_1 is pin 2 on gpio0. The LED is on when the pin is high,
    and off when it is low.
  - led_2 is pin 15 on gpio1. The LED is on when the pin is low,
    and the pin's internal pull-up resistor should be enabled.

child-binding:
  description: GPIO output node

  properties:
      gpios:
        type: phandle-array
        required: true
      label:
        required: false
        type: string
        description: |
          Human readable string describing the pin. It can be used by an
          application to identify this pin or to retrieve its number/index
          (i.e. child node number) on the parent device.
```

## src/main.c
```c
/*
 * Copyright (c) 2016 Intel Corporation
 *
 * SPDX-License-Identifier: Apache-2.0
 */

#include <stdio.h>
#include <zephyr/kernel.h>
#include <zephyr/drivers/gpio.h>
#include <zephyr/drivers/i2c.h>

#include <zephyr/logging/log.h>
LOG_MODULE_REGISTER(rgbi, LOG_LEVEL_INF);

#include "rgb-indicator.h"

#define LOOP_SLEEP_MS 1000
#define COLOR_SLEEP_MS 500

#define HXRQST_NODE DT_NODELABEL(hxrqst)
#define HXCTRL_NODE DT_NODELABEL(hxctrl)
#define RGBCTRL_NODE DT_NODELABEL(rgbctrl)

static const struct gpio_dt_spec hxrqst = GPIO_DT_SPEC_GET(HXRQST_NODE, gpios);
static const struct gpio_dt_spec hxctrl = GPIO_DT_SPEC_GET(HXCTRL_NODE, gpios);
static const struct i2c_dt_spec rgbctrl = I2C_DT_SPEC_GET(RGBCTRL_NODE);

// #define BMP_NODE DT_NODELABEL(bmp)
// #define SHT_NODE DT_NODELABEL(sht)
// static const struct i2c_dt_spec bmp_snsr = I2C_DT_SPEC_GET(BMP_NODE);
// static const struct i2c_dt_spec sht_snsr = I2C_DT_SPEC_GET(SHT_NODE);

// static const struct led_rgb LED_OFF = RGB(0,0,0);
// static const struct led_rgb LED_RED = RGB(100,0,0);
// static const struct led_rgb LED_GREEN = RGB(0,100,0);
// static const struct led_rgb LED_BLUE = RGB(0,0,100);

static const struct led_rgb colors[] = {
    RGB(0, 0, 0),
    RGB(100, 0, 0),         /* red */
    RGB(0, 0, 0),
    RGB(0, 100, 0),         /* green */
    RGB(0, 0, 0),
    RGB(0, 0, 100),         /* blue */
    RGB(0, 0, 0),
    RGB(100, 100, 100),     /* white */
    RGB(0, 0, 0),
    RGB(100, 100, 0),       /* yellow */ 
    RGB(0, 0, 0),
    RGB(0, 100, 100),       /* cyan */
    RGB(0, 0, 0),
    RGB(100, 0, 100),       /* magenta */
    RGB(0, 0, 0)
};

rgb_indicator_t rgbi;

int main(void)
{
    int ret;
    int loopcount = 0;

    printf("Hello %s, welcome to the IoT world and watch out for green flashes on the horizon! \r\n", CONFIG_BOARD_TARGET);

    if (!gpio_is_ready_dt(&hxrqst) ||
        !gpio_is_ready_dt(&hxctrl) ||
        !device_is_ready(rgbctrl.bus) 
        // !device_is_ready(bmp_snsr.bus) ||
        // !device_is_ready(sht_snsr.bus)
       )
    {
        LOG_ERR("Required devices not ready");
        return 0;
    }

    ret  = gpio_pin_configure_dt(&hxrqst, GPIO_OUTPUT_ACTIVE) < 0 ? 1 : 0;
    ret += gpio_pin_configure_dt(&hxctrl, GPIO_OUTPUT_ACTIVE) < 0 ? 1 : 0;
    if (ret != 0)
    {
        LOG_ERR("Unable to configure I/O");
        return 0;
    }

    ret = rgbi_init(&rgbctrl, &rgbi);
    if (ret != 0)
    {
        printk("Failed to initalize the RGB indicator, err=%d\r\n", ret);
    }

    // rgbi_setColor(&rgbi, &LED_OFF);
    // rgbi_setColor(&rgbi, &LED_RED);                 // got green, blue, red
    // k_msleep(1000);
    // rgbi_setColor(&rgbi, &LED_GREEN);
    // k_msleep(1000);
    // rgbi_setColor(&rgbi, &LED_BLUE);
    // k_msleep(1000);
    // rgbi_setColor(&rgbi, &LED_OFF);

    for (size_t i = 0; i < sizeof(colors)/3; i++)       // cycle through primary/secondary colors
    {
        rgbi_setColor(&rgbi, &colors[i]);
        k_msleep(COLOR_SLEEP_MS);
    }

    while (1)
    {
        ret =  gpio_pin_toggle_dt(&hxrqst) < 0 ? 1 : 0;
        ret += gpio_pin_toggle_dt(&hxctrl) < 0 ? 1 : 0;
        if (ret != 0)
        {
            LOG_ERR("I/O error on pin output");
            return 0;
        }

         

        loopcount++;
        printf("Loops: %d\n", loopcount);
        k_msleep(LOOP_SLEEP_MS);
    }
    return 0;
}
```
